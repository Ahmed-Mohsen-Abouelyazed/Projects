KEYPAD_PORT EQU P1
C1 BIT P1.0
C2 BIT P1.1
C3 BIT P1.2
C4 BIT P1.3
RO4 BIT P1.4
RO3 BIT P1.5
RO2 BIT P1.6
RO1 BIT P1.7
LCD_PORT EQU P3
Rs BIT P2.6
E BIT P2.7
SIGNAL_TYPE EQU 90H
SAB BIT P3.4
;************************************************************************************

ORG 200H                                        
	ERR: DB ' ERROR',0	

ORG 300H                                        ;INITIAL MESSAGE
	WELCOME_MSG: DB 'HELLO WORLD!',0

ORG 310H                         
	HZ_MSG: DB 'HZ',0
		
ORG 320H                                        ;KEYBOARD BUTTONS
	ROW1: DB 'U','3','2','1',0
	ROW2: DB 'U','6','5','4',0
	ROW3: DB 'U','9','8','7',0
	ROW4: DB 'U',' ','0','.',0

ORG 400H                                        
	FREQUENCY_MSG: DB ' ENTER F = ',0

ORG 500H
	SIGNAL_TYPE_MSG: DB 'ENTER SIG TYP: ',0
		
ORG 600H
	SIN_FUN_VALUES: DB 128,150,172,192,210,226,239,248,253,255,253,248,239,226,210,192,172,150,128,106,84,64,46,30,17,8,2,0,2,8,17,30,46,64,84,106,128
		
ORG 800H
	OUT_OF_RANGE_MESSAGE: DB ' OUT OF RANGE! ',0

;************************************************************************************
HELLO_MSG:
MOV DPTR,#300H					;Send Hello message
AGAIN1:
CLR A
MOVC A,@A+DPTR
JZ HERE1
LCALL LCD_DATA
INC DPTR
SJMP AGAIN1
HERE1:                                           
LCALL DELAY
LCALL DELAY
RET

;************************************************************************************
SIG_TYP_MSG:
MOV DPTR,#500H					;Send signal type message
AGAIN2:
CLR A
MOVC A,@A+DPTR
JZ HERE2
LCALL LCD_DATA
INC DPTR
SJMP AGAIN2
HERE2:
RET

;************************************************************************************
ENT_FREQ_MSG:
MOV DPTR,#400H
FREQUENCY_AGAIN:
CLR A
MOVC A,@A+DPTR
JZ GET_FREQUENCY_
LCALL LCD_DATA
INC DPTR
SJMP FREQUENCY_AGAIN
RET
GET_FREQUENCY_:
LJMP GET_FREQUENCY

;************************************************************************************
ERROR_MESSAGE:
LCALL LCD_INIT
MOV DPTR,#200H
ERR_AGAIN:
CLR A
MOVC A,@A+DPTR
JZ ERR_F
LCALL LCD_DATA
INC DPTR
SJMP ERR_AGAIN
ERR_F:
LCALL DELAY
LCALL DELAY
LCALL LCD_INIT
LJMP START_AGAIN
RET

;************************************************************************************
HZ_TYPE:	
MOV DPTR,#310H
HZ_AGAIN:
CLR A
MOVC A,@A+DPTR
JZ OUT_MSG
LCALL LCD_DATA
INC DPTR
SJMP HZ_AGAIN
OUT_MSG:RET

;************************************************************************************
OORM:
LCALL LCD_INIT
MOV DPTR,#800H
ERROR_AGAIN:
CLR A
MOVC A,@A+DPTR
LCALL LCD_DATA
INC DPTR
SJMP ERROR_AGAIN
LCALL LCD_INIT
RET

;***************************** SAWTOOTH WAVE FUNCTION *****************************
FUN_SAWTOOTH:
AGAIN_SAW:
MOV R7,#255
MOV A,#00H
LCALL CALC_DEL_SAW
REPEAT:
MOV P1,A
INC A
//LCALL DELAY_SAWTOOTH
DJNZ R7,REPEAT
CLR A
JB SAB,SELECT_AGAIN
SJMP AGAIN_SAW
RET

;***************************** CALCULATE SAWTOOTH DELAY FUNCTION *****************************
CALC_DEL_SAW:
MOV A,30H
MOV B,#10
MUL AB					;MAX FREQUENCY = 46.08 KHz
MOV B,31H
ADD A,B
CJNE A,#46,NOT_EQU
SJMP SOE_46

NOT_EQU:
JNC OUT_OF_RANGE

SOE_46:
MOV B,A
MOV A,#230
DIV AB
//LCALL STR_TIMER
RET

OUT_OF_RANGE:
LCALL OORM
LJMP START_AGAIN
RET

;***************************** SQUARE WAVE FUNCTION *****************************
FUN_SQUARE:
//LCALL CALC_DEL_SQU

AGAIN_SQR:
MOV P1,#255
//LCALL DELAY_SQUARE
MOV P1,#0
//LCALL DELAY_SQUARE
JB SAB,SELECT_AGAIN
SJMP AGAIN_SQR
RET

;***************************** SINE WAVE FUNCTION *****************************
FUN_SINE:
AGAIN_SINE: 
MOV DPTR,#600H
MOV R2,#36
BACK_SINE:
CLR A
MOVC A,@A+DPTR
MOV P1,A
INC DPTR
DJNZ R2, BACK_SINE
JB SAB,SELECT_AGAIN
SJMP AGAIN_SINE
RET
SELECT_AGAIN:
LJMP SELECT_AGAIN_
;*************************************** 			MAIN PROGRAM 			*********************************************

;INITIATE THE PROGRAM
START_AGAIN:
ORG 30H
MOV P0,#0FFH					;P0 is connected to KEYPAD as an input port	
MOV KEYPAD_PORT,#0FH                        
LCALL LCD_INIT
LCALL HELLO_MSG

SELECT_AGAIN_:
LCALL LCD_INIT

;**********************GET 	SIGNAL TYPE FROM THE USER***************************

LCALL SIG_TYP_MSG
LCALL READ_KEY					;GET SIGNAL TYPE FROM KEYPAD
LCALL LCD_DATA
LCALL DELAY
LCALL DELAY
ANL A,#0FH
MOV SIGNAL_TYPE,A

;**********************GET THE FREQUENCY FROM THE USER***************************

LCALL LCD_INIT
LCALL ENT_FREQ_MSG

GET_FREQUENCY:
;FOR FIRST DIGIT "HIGH"
LCALL READ_KEY
LCALL LCD_DATA
ANL A,#0FH
MOV 31H,A
;FOR SECOND DIGIT  "LOW"
LCALL READ_KEY
LCALL LCD_DATA
ANL A,#0FH
MOV 30H,A			
;NOW WE GOT THE FREQUENCY'S HEX IN 31(HIGH) & 30(LOW)
;***********************TO TYPE THE WORD HZ*******************************
SPACE_TYPE:
MOV A,#00H
LCALL LCD_DATA
LCALL HZ_TYPE

;*******************TO SHOW FREQUENCY ON THE LCD*********************
/*LCALL READ_KEY
START_EXCUTING:
;SHOW LCD WHILE DRAWING
LCALL LCD_2ND_LINE			;COMMAND TO TYPE IN THE SECOND LINE
MOV A,#20H
LCALL LCD_DATA				;SPACES
LCALL LCD_DATA
MOV A,31H					;FREQUENCY
LCALL LCD_DATA
MOV A,30H
LCALL LCD_DATA
MOV A,#2EH					;ASCI OF POINT
LCALL LCD_DATA
MOV A,R1					;AFTER POINT FREQUENCY
LCALL LCD_DATA
LCALL HZ_TYPE
MOV A,#20H					;SPACES
LCALL LCD_DATA
LCALL LCD_DATA
LCALL LCD_DATA
LCALL LCD_DATA
LCALL LCD_DATA*/

;**********************************************************************************
SETTING_UP_THE_DIGITS:
;FIRST WE CONVERT THEM FROM ASCII TO NUMBERS AND STORE THEM
MOV A,31H
ANL A,#0FH
MOV 31H,A

MOV A,30H
ANL A,#0FH
MOV 30H,A

MOV A,SIGNAL_TYPE
CJNE A,#1,NOT_FUN_SAWTOOTH
LCALL FUN_SAWTOOTH
//LJMP 
NOT_FUN_SAWTOOTH:
CJNE A,#2,NOT_FUN_SQUARE
LCALL FUN_SQUARE
//LJMP
NOT_FUN_SQUARE:
CJNE A,#3,ERROR
LCALL FUN_SINE
//LJMP
ERROR: LCALL ERROR_MESSAGE
LJMP START_AGAIN

LJMP END_PROGRAM

;***********************************************************************************

;KEYPAD INTERFACING

READ_KEY:
CHECK_1:                                        ;CHECK IF A BUTTON WAS PRESSED
CLR RO1
CLR RO2
CLR RO3
CLR RO4

MOV A,KEYPAD_PORT
ANL A,#0FH
CJNE A,#0FH,CHECK_2
SJMP CHECK_1
CHECK_2:                                        ;MAYBE IT WAS JUST A SPIKE NOISE SO, WAIT FOR DEBOUNCE AND CHECK AGAIN
ACALL DELAY
MOV A,KEYPAD_PORT
ANL A,#0FH
CJNE A,#0FH,CHECK_ROW
SJMP CHECK_1

CHECK_ROW:                                      ;CHECK IN WHICH ROW THE PRESSED BUTTON IS
CLR RO1
SETB RO2
SETB RO3
SETB RO4
MOV A,KEYPAD_PORT
CJNE A,#01111111B,ROW_1

SETB RO1
CLR RO2
SETB RO3
SETB RO4
MOV A,KEYPAD_PORT
CJNE A,#10111111B,ROW_2

SETB RO1
SETB RO2
CLR RO3
SETB RO4
MOV A,KEYPAD_PORT
CJNE A,#11011111B,ROW_3

SETB RO1
SETB RO2
SETB RO3
CLR RO4
MOV A,KEYPAD_PORT
CJNE A,#11101111B,ROW_4

LJMP CHECK_1

ROW_1:                                          ;PUT THE ADDRESS OF THE RIGHT ROW IN DPTR
MOV DPTR,#ROW1
SJMP FIND
ROW_2:
MOV DPTR,#ROW2
SJMP FIND
ROW_3:
MOV DPTR,#ROW3
SJMP FIND
ROW_4:
MOV DPTR,#ROW4
SJMP FIND

FIND:                                           ;FIND IN WHICH COLUMN THE PRESSED BUTTON IS
RRC A
JNC MATCH
INC DPTR
SJMP FIND

MATCH:                                          ;TAKE THE NUBER AND WRITE IT ON THE LCD
CLR A
MOVC A,@A+DPTR
CJNE A,#'C',PRINT
LCALL LCD_INIT
RET
PRINT:
RET

;*****************************
;LCD INTERFACING
LCD_INIT:
MOV A,#80H                                      ;FORCE CURSOR TO 1ST LINE
ACALL LCD_COMMAND
MOV A,#38H                                      ;2 LINES AND 5*7 MATRIX
ACALL LCD_COMMAND
MOV A,#0EH                                      ;DISPLAY ON, CURSOR BLINKING
ACALL LCD_COMMAND
MOV A,#01H                                      ;CLEAR DISPLAY SCREEN
ACALL LCD_COMMAND
RET
LCD_2ND_LINE:
MOV A,#0C0H                                      ;START 2ND LINE 
ACALL LCD_COMMAND
RET
LCD_COMMAND:                                    ;APPLY A COMMAND TO THE LCD
MOV LCD_PORT,A
CLR Rs
SETB E
CLR E
ACALL DELAY
RET
LCD_DATA:                                       ;WRITE TO THE LCD
MOV LCD_PORT,A
SETB Rs
SETB E
CLR E
MOV R3,#60H
ACALL LOOP2
RET

DELAY:                                          ;USED FOR BOTH LCD AND DEBOUNCING DELAY
MOV R3,#150D
LOOP2: MOV R2,#255D
LOOP1: DJNZ R2,LOOP1
DJNZ R3,LOOP2
RET

SL_CURSOR:
MOV A,#10H                                      ;SHIFT LEFT CURSOR 
ACALL LCD_COMMAND
RET

END_PROGRAM:
END
